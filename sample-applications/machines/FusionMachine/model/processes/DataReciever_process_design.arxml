AUTOSAR XML (schema 00051)
package /apd/Machine/FusionMachine/ProcessDesign
  process design DataReciever: executable=DataReciever
