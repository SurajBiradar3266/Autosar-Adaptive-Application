AUTOSAR XML (schema 00051)
package /apd/Machines/DltMappings
  dlt application to process mapping DataRecieverDltApplicationToProcessMapping: dlt-application=DataRecieverLogApplication, process=DataReciever
  dlt log sink to port prototype mapping DataRecieverDltLogSinkToPortPrototypeMapping: dlt-context=DefaultDltContext, dlt-log-sink=[DataRecieverFileDltSink, RemoteDltSink, ConsoleDltSink], process=DataReciever
package /apd/Machines/FusionMachine/ProcessToMachineMappings
  process to machine mapping set DataReciever
    process to machine mapping DataReciever: machine=FusionMachine, process=DataReciever
package /apd/Machines/FusionMachine/Processes
  process DataReciever: design=DataReciever, executable=DataReciever, state-dependent-startup-config{function-group-state=[MachineFG.Driving, MachineFG.Parking], resource-group=ResourceGroup1, startup-config=DataReciever}
    process state machine state_machine: type=ProcessStateMachine
package /apd/Machines/FusionMachine/ServiceInstanceToPortPrototypeMappings
  service instance to port prototype mapping DataReciever_RequiredServiceInstance_toPort: port-prototype=DistanceDataInterface_RPort, process=DataReciever, service-instance=DistanceDataRequiredSomeipServiceInstance
package /apd/Machines/FusionMachine/StartupConfigSets
  startup config DataReciever: environment-variables=tag-with-optional-value={key=VSOMEIP_CONFIGURATION, value=/etc/vsomeip.json}, scheduling-policy=SCHEDULING-POLICY-ROUND-ROBIN, scheduling-priority=11, termination-behavior=PROCESS-IS-NOT-SELF-TERMINATING
