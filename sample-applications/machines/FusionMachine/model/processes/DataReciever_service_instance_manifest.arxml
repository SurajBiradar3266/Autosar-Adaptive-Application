AUTOSAR XML (schema 00051)
package /apd/Machines/FusionMachine/ServiceInstanceToMachineMappings
  someip service instance to machine mapping DataReciever_RequiredServiceInstance_toMachine: communication-connector=FusionConnector, service-instance=DistanceDataRequiredSomeipServiceInstance, udp-port=TriggerApplicationEndpoint
package /apd/Machines/FusionMachine/ServiceInstances
  required someip service instance DistanceDataRequiredSomeipServiceInstance: service-interface-deployment=DistanceDataInterface_someip, required-service-instance-id=98, sd-client-config=SomeipSdClientServiceInstanceConfig
    someip required event group RequiredEventGroup: event-group=SomeipEventgroup1
