AUTOSAR XML (schema 00051)
package /apd/Machines/RadarMachine/ServiceInstanceToMachineMappings
  someip service instance to machine mapping DataSender_ProvidedServiceInstance_toMachine: communication-connector=RadarConnector, service-instance=DataSenderProvidedSomeipServiceInstance, udp-port=TriggerApplicationEndpoint
package /apd/Machines/RadarMachine/ServiceInstances
  provided someip service instance DataSenderProvidedSomeipServiceInstance: service-interface-deployment=DistanceDataInterface_someip, sd-server-config=SomeipSdServerServiceInstanceConfig, service-instance-id=98
    someip provided event group RequiredEventgroup1: event-group=SomeipEventgroup1, multicast-threshold=0
