AUTOSAR XML (schema 00051)
package /apd/Machines/RadarMachine/DltLogChannelToProcessMappings
  dlt application to process mapping DataSenderDltApplicationToProcessMapping: dlt-application=DataSenderApplication, process=DataSender
  dlt log sink to port prototype mapping DataSenderDltLogSinkToPortPrototypeMapping: dlt-context=DefaultDltContext, dlt-log-sink=[DataSenderFileDltSink, RemoteDltSink, ConsoleDltSink], process=DataSender
package /apd/Machines/RadarMachine/ProcessToMachineMappings
  process to machine mapping set DataSender
    process to machine mapping DataSender: machine=RadarMachine, process=DataSender
package /apd/Machines/RadarMachine/Processes
  process DataSender: design=DataSender, executable=DataSender, state-dependent-startup-config{function-group-state=[MachineFG.Driving, MachineFG.Parking], resource-group=ResourceGroup1, startup-config=DataSenderStartup}
    process state machine state_machine: type=ProcessStateMachine
package /apd/Machines/RadarMachine/ServiceInstanceToPortPrototypeMappings
  service instance to port prototype mapping DataSender_ProvidedServiceInstance_toPort: port-prototype=DistanceDataInterface_PPort, process=DataSender, service-instance=DataSenderProvidedSomeipServiceInstance
package /apd/Machines/RadarMachine/StartupConfigSets
  startup config DataSenderStartup: environment-variables=tag-with-optional-value={key=VSOMEIP_CONFIGURATION, value=/etc/vsomeip.json}, scheduling-policy=SCHEDULING-POLICY-ROUND-ROBIN, scheduling-priority=12, termination-behavior=PROCESS-IS-NOT-SELF-TERMINATING
