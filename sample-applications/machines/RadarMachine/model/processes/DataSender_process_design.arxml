AUTOSAR XML (schema 00051)
package /apd/Machines/RadarMachine/ProcessDesigns
  process design DataSender: executable=DataSender
