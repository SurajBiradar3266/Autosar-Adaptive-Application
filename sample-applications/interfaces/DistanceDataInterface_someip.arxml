AUTOSAR XML (schema 00051)
package /apd/ServiceInterfaceDeployments
  someip service interface deployment DistanceDataInterface_someip: service-interface=DistanceDataInterface, service-interface-id=98, service-interface-version={major-version=1, minor-version=0}
    someip event deployment DistanceDataEvent_someip: event=DistanceDataEvent, event-id=1, transport-protocol=UDP
    someip event group SomeipEventgroup1: event-group-id=1, event=DistanceDataEvent_someip
