AUTOSAR XML (schema 00051)
package /apd/ServiceInterfaces
  service interface DistanceDataInterface
    namespaces:
      symbol props apd
      symbol props sample
    events:
      data DistanceDataEvent: type=double
