AUTOSAR XML (schema 00051)
package /apd/AdaptiveApplicationSwComponentTypes
  adaptive application sw component type DataReciever
    require port DistanceDataInterface_RPort: required-interface=DistanceDataInterface
package /apd/Executables
  executable DataReciever: category=APPLICATION_LEVEL, minimum-timer-granularity=1000
    root sw component prototype DataReciever: application-type=DataReciever
