AUTOSAR XML (schema 00051)
package /apd/AdaptiveApplicationSwComponentTypes
  adaptive application sw component type DataSender
    provide port DistanceDataInterface_PPort: provided-interface=DistanceDataInterface
package /apd/Executables
  executable DataSender: category=APPLICATION_LEVEL, minimum-timer-granularity=1000
    root sw component prototype DataSender: application-type=DataSender
