AUTOSAR XML (schema 00051)
package /apd/Dlt
  dlt log sink DataSenderFileDltSink: category=DLT_LOGSINK_FILE, default-log-threshold=VERBOSE, path=/var/redirected/DataSender
  dlt log sink DataRecieverFileDltSink: category=DLT_LOGSINK_FILE, default-log-threshold=VERBOSE, path=/var/redirected/DataReciever
